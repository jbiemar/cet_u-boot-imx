## board/freescale/imx6qpfatmaninviewx/Kconfig
```kconfig
if TARGET_IMX6QPFATMANINVIEWX

config SYS_BOARD
	default "imx6qpfatmaninviewx"

config SYS_VENDOR
	default "freescale"

config SYS_CONFIG_NAME
	default "imx6qpfatmaninviewx"

endif
```

## configs/imx6qpfatmaninviewx_defconfig
```kconfig
CONFIG_ARM=y
CONFIG_ARCH_MX6=y
CONFIG_TARGET_IMX6QPFATMANINVIEWX=y
CONFIG_SYS_EXTRA_OPTIONS="IMX_CONFIG=board/freescale/imx6qpfatmaninviewx/imx6qpfatmaninviewx.cfg,MX6QP"
CONFIG_CMD_GPIO=y
CONFIG_SYS_MALLOC_F=y
CONFIG_SYS_MALLOC_F_LEN=0x800
CONFIG_DM=y
CONFIG_DM_THERMAL=y
```
